## boards/shields/glove51tb/Kconfig.defconfig
```kconfig
if SHIELD_GLOVE51tb_R

config ZMK_KEYBOARD_NAME
    default "glove51tb_R"

config ZMK_SPLIT
    default y

config ZMK_SPLIT_ROLE_CENTRAL
    default y

endif

if SHIELD_GLOVE51tb_L

config ZMK_KEYBOARD_NAME
    default "glove51tb_L"

config ZMK_SPLIT
    default y

endif
```

## boards/shields/glove51tb/Kconfig.shield
```kconfig
config SHIELD_GLOVE51tb_R
    def_bool $(shields_list_contains,glove51tb_R)

config SHIELD_GLOVE51tb_L
    def_bool $(shields_list_contains,glove51tb_L)
```
